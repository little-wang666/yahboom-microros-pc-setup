## esp32_firmware/yahboom_esp32_micro_ros_car/sdkconfig.defaults
```kconfig
# ESP-IDF default configuration.
# Keep this file ASCII-only because ESP-IDF kconfgen may decode it with the
# Windows active code page. Chinese explanations live in README_zh.md and code.

CONFIG_FREERTOS_HZ=1000
```
